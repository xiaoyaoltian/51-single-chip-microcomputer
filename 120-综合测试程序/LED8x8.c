/*******************************************************************************
* 版  权 	: 红梅科技工作室
* 论  坛	：https://blog.csdn.net/Qingzhusshuiyun
* Q Q	    ：2369099714
* 版权所有，盗版必究。
* 工  程   : 综合测试
* 文件名   : 综合测试.c
* 处理器   : STC89C52RC
* 编译环境 : Keil 5
* 系统时钟 : 12MHZ
* 版    本	: V1.0 
* 生成日期	: 2018-08-29	   					
* 修改日期	:  
* 简单描述 : 使用hc595驱动双色点阵
*******************************************************************************/
 
#include<reg52.h>    //包含头文件，一般情况不需要改动，头文件包含特殊功能寄存器的定义
#include <intrins.h> 
#include "LED8x8.h"
#include "delay.h"

unsigned char  segout[8]={0x01,0x02,0x04,0x08,0x10,0x20,0x40,0x80}; //8列
/*------------------------------------------------
                硬件端口定义
------------------------------------------------*/

sbit LATCH = P1^0; 
sbit SRCLK= P1^1;
sbit SER  = P1^2;


sbit LATCH_B = P2^2;
sbit SRCLK_B= P2^1;
sbit SER_B= P2^0;


/*------------------------------------------------
                发送字节程序
------------------------------------------------*/
void Send1Byte(unsigned char dat)
{    
  unsigned char i; 
        
   for(i=0;i<8;i++)
        {
         SRCLK=0;
         SER=dat&0x80;
         dat<<=1;
         SRCLK=1;
         }
         
}
/*------------------------------------------------
                发送双字节程序
     595级联，n个595，就需要发送n字节后锁存
------------------------------------------------*/
void Send2Byte(unsigned char dat1,unsigned char dat2)
{    
   Send1Byte(dat1);
   Send1Byte(dat2);      
}
/*------------------------------------------------
                   595锁存程序
		  595级联发送数据后，锁存有效
------------------------------------------------*/
void Out595(void)
{
        LATCH=0;
        _nop_();
        LATCH=1;
}

/*------------------------------------------------
                发送位码字节程序
               使用另外一片单独595
------------------------------------------------*/
void SendSeg(unsigned char dat)
{    
unsigned char i; 
        
   for(i=0;i<8;i++)  //发送字节
        {
         SRCLK_B=0;
         SER_B=dat&0x80;
         dat<<=1;
         SRCLK_B=1;
         }
      LATCH_B=0;    //锁存
      _nop_();
      LATCH_B=1;
         
         
}
/*------------------------------------------------
                   全屏显示
------------------------------------------------*/
void LED8x8Display(void)
{
 static unsigned char i;
 SendSeg(segout[i]);
 Send2Byte(0,0);
 Out595();
 i++;
 if(i==8)
   i=0;
}