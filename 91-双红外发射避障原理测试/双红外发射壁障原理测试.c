/*******************************************************************************
* 版  权 	: 红梅科技工作室
* 论  坛	：https://blog.csdn.net/Qingzhusshuiyun
* Q Q	    ：2369099714
* 版权所有，盗版必究。
* 工  程   : 双红外发射壁障原理测试
* 文件名   : 双红外发射壁障原理测试.c
* 处理器   : STC89C52RC
* 编译环境 : Keil 5
* 系统时钟 : 12MHZ
* 版    本	: V1.0 
* 生成日期	: 2018-07-31	   					
* 修改日期	:  
* 简单描述 : 通过2路红外发射，顺序接收，检测收发功能是否正常
        用手遮挡对应的发射管，用共阳数码管的a、d端模拟左右2端
		每60ms分别检测2路发射，通过每组发射10个脉冲，如果接收到的脉冲个数大于6，表明有遮挡存在
*******************************************************************************/

#include<reg52.h> //包含头文件，一般情况不需要改动，头文件包含特殊功能寄存器的定义
/*------------------------------------------------
              硬件端口连接定义
------------------------------------------------*/

#define DataPort P0 //定义数据端口 程序中遇到DataPort 则用P0 替换

sbit IRSend_A=P1^2;  //定义红外发射 A
sbit IRSend_B=P1^3;  //定义红外发射 B
sbit IRRev =P3^2;    //接收接口


bit  Flag;
bit  Left_Flag;  //定义 是否存在遮挡标志位。为1表示有遮挡
bit  Right_Flag;
/*------------------------------------------------
                  函数声明
------------------------------------------------*/
void Init_Timer0(void);//定时器初始化
void DelayUs2x(unsigned char t);
void IR_Send_Rev (void);
/*------------------------------------------------
                    主函数
------------------------------------------------*/
void main (void)
{

  Init_Timer0();

while (1)   //主循环
  {
  if(Flag)
     {
	  
	  IR_Send_Rev ();

	  if(Right_Flag)   //利用数码管的a，和d 段的亮灭表示左右遮挡情况
	    DataPort |=0x08;
	  else
	    DataPort &=0x01;

      if(Left_Flag)
	    DataPort |=0x01;
	  else
	    DataPort &=0x08;				
	 }
  }
}

/*------------------------------------------------
                    定时器初始化子程序
------------------------------------------------*/
void Init_Timer0(void)
{
 TMOD |= 0x01;	  //使用模式1，16位定时器，使用"|"符号可以在使用多个定时器时不受影响		     
 //TH0=0x00;	      //给定初值
 //TL0=0x00;
 EA=1;            //总中断打开
 ET0=1;           //定时器中断打开
 TR0=1;           //定时器开关打开
}
/*------------------------------------------------
                 定时器中断子程序
------------------------------------------------*/
void Timer0_isr(void) interrupt 1 
{

 TH0=(65536-60000)/256;		  //重新赋值 60ms
 TL0=(65536-60000)%256;
 
 Flag=!Flag;

}

/*------------------------------------------------
 uS延时函数，含有输入参数 unsigned char t，无返回值
 unsigned char 是定义无符号字符变量，其值的范围是
 0~255 这里使用晶振12M，精确延时请使用汇编,大致延时
 长度如下 T=tx2+5 uS 
------------------------------------------------*/
void DelayUs2x(unsigned char t)
{   
 while(--t);
}
/*------------------------------------------------
             2路红外发射接收函数
通过每组发射10个脉冲，如果接收到的脉冲个数大于6，
表明有遮挡存在，通过2路发射接收得到遮挡结果组合，
可以判断障碍物位置。从而进行前进、后退、左转、右转
------------------------------------------------*/
void IR_Send_Rev (void)
{
unsigned char i,pulse_num;

IRSend_A=0; //关闭2个发射管
IRSend_B=0;

    pulse_num=0;//清零脉冲计数 
	for(i=0;i<10;i++)
	 	{
     	IRSend_B=1;//打开B发射
	 	DelayUs2x(150);
	 	if(! IRRev)
	  	    pulse_num++;
     	IRSend_B=0;//关闭B发射
     	DelayUs2x(150);
		}

	if(pulse_num>6)
	   Left_Flag=1;//如果判断有障碍，点亮LED_B指示，否则熄灭
	else
	   Left_Flag=0;

	pulse_num=0;   //脉冲计数
	for(i=0;i<10;i++)
	 	{
     	IRSend_A=1;//打开A发射
		DelayUs2x(150);
	 	if(! IRRev)
	   		pulse_num++;
    	IRSend_A=0;//关闭A发射
     	DelayUs2x(150);
		}
	if(pulse_num>6)
	   Right_Flag=1;//如果判断有障碍，点亮LED_A指示，否则熄灭
	else
	   Right_Flag=0;




}



